/*
 * Copyright (c) 2014, The Linux Foundation. All rights reserved.
 *
 * This program is free software; you can redistribute it and/or modify
 * it under the terms of the GNU General Public License version 2 and
 * only version 2 as published by the Free Software Foundation.
 *
 * This program is distributed in the hope that it will be useful,
 * but WITHOUT ANY WARRANTY; without even the implied warranty of
 * MERCHANTABILITY or FITNESS FOR A PARTICULAR PURPOSE.  See the
 * GNU General Public License for more details.
 */

&mdss_mdp {
	dsi_jd9366_video: qcom,mdss_dsi_jd9366_video {
		qcom,mdss-dsi-panel-name = "jd9366 video mode dsi panel";
		qcom,mdss-dsi-panel-controller = <&mdss_dsi0>;
		qcom,mdss-dsi-panel-type = "dsi_video_mode";
		qcom,mdss-dsi-panel-destination = "display_1";
		qcom,mdss-dsi-panel-framerate = <60>;
		qcom,mdss-dsi-virtual-channel-id = <0>;
		qcom,mdss-dsi-stream = <0>;
		qcom,mdss-dsi-panel-width = <800>;
		qcom,mdss-dsi-panel-height = <1280>;
		qcom,mdss-dsi-h-front-porch = <100>;
		qcom,mdss-dsi-h-back-porch = <100>;
		qcom,mdss-dsi-h-pulse-width = <20>;
		qcom,mdss-dsi-h-sync-skew = <0>;
		qcom,mdss-dsi-v-back-porch = <4>;
		qcom,mdss-dsi-v-front-porch = <16>;
		qcom,mdss-dsi-v-pulse-width = <4>;
		qcom,mdss-dsi-h-left-border = <0>;
		qcom,mdss-dsi-h-right-border = <0>;
		qcom,mdss-dsi-v-top-border = <0>;
		qcom,mdss-dsi-v-bottom-border = <0>;
		qcom,mdss-dsi-bpp = <24>;
		//qcom,mdss-dsi-color-order = "rgb_swap_rgb";
		qcom,mdss-dsi-underflow-color = <0xff>;
		qcom,mdss-dsi-border-color = <0>;
		qcom,mdss-dsi-on-command = [
			29 01 00 00 01 00 02 E0 00
			29 01 00 00 01 00 02 E1 93
			29 01 00 00 01 00 02 E2 65
			29 01 00 00 01 00 02 E3 F8
			29 01 00 00 01 00 02 E6 02
			29 01 00 00 01 00 02 E7 02
			29 01 00 00 01 00 02 E0 01
			29 01 00 00 01 00 02 00 00
			29 01 00 00 01 00 02 01 B7
			29 01 00 00 01 00 02 17 00
			29 01 00 00 01 00 02 18 B2
			29 01 00 00 01 00 02 19 01
			29 01 00 00 01 00 02 1A 00
			29 01 00 00 01 00 02 1B B2
			29 01 00 00 01 00 02 1C 01
			29 01 00 00 01 00 02 1F 7E
			29 01 00 00 01 00 02 20 28
			29 01 00 00 01 00 02 21 28
			29 01 00 00 01 00 02 22 0E
			29 01 00 00 01 00 02 24 C8
			29 01 00 00 01 00 02 37 29
			29 01 00 00 01 00 02 38 05
			29 01 00 00 01 00 02 39 08
			29 01 00 00 01 00 02 3A 12
			29 01 00 00 01 00 02 3C 78
			29 01 00 00 01 00 02 3E FF
			29 01 00 00 01 00 02 3E FF
			29 01 00 00 01 00 02 3F FF
			29 01 00 00 01 00 02 40 06
			29 01 00 00 01 00 02 41 A0
			29 01 00 00 01 00 02 43 08
			29 01 00 00 01 00 02 44 07
			29 01 00 00 01 00 02 45 24
			29 01 00 00 01 00 02 55 01
			29 01 00 00 01 00 02 56 01
			29 01 00 00 01 00 02 57 8D
			29 01 00 00 01 00 02 58 0A
			29 01 00 00 01 00 02 59 2A
			29 01 00 00 01 00 02 5A 2A
			29 01 00 00 01 00 02 5B 1E
			29 01 00 00 01 00 02 5D 7C
			29 01 00 00 01 00 02 5E 59
			29 01 00 00 01 00 02 5F 47
			29 01 00 00 01 00 02 60 39
			29 01 00 00 01 00 02 61 33
			29 01 00 00 01 00 02 62 23
			29 01 00 00 01 00 02 63 27
			29 01 00 00 01 00 02 64 10
			29 01 00 00 01 00 02 65 27
			29 01 00 00 01 00 02 66 25
			29 01 00 00 01 00 02 67 23
			29 01 00 00 01 00 02 68 3F
			29 01 00 00 01 00 02 69 2C
			29 01 00 00 01 00 02 6A 33
			29 01 00 00 01 00 02 6B 25
			29 01 00 00 01 00 02 6C 23
			29 01 00 00 01 00 02 6D 17
			29 01 00 00 01 00 02 6E 0A
			29 01 00 00 01 00 02 6F 00
			29 01 00 00 01 00 02 70 7C
			29 01 00 00 01 00 02 71 59
			29 01 00 00 01 00 02 72 47
			29 01 00 00 01 00 02 73 39
			29 01 00 00 01 00 02 74 33
			29 01 00 00 01 00 02 75 23
			29 01 00 00 01 00 02 76 27
			29 01 00 00 01 00 02 77 10
			29 01 00 00 01 00 02 78 27
			29 01 00 00 01 00 02 79 25
			29 01 00 00 01 00 02 7A 23
			29 01 00 00 01 00 02 7B 3F
			29 01 00 00 01 00 02 7C 2C
			29 01 00 00 01 00 02 7D 33
			29 01 00 00 01 00 02 7E 25
			29 01 00 00 01 00 02 7F 23
			29 01 00 00 01 00 02 80 17
			29 01 00 00 01 00 02 81 0A
			29 01 00 00 01 00 02 82 00
			29 01 00 00 01 00 02 E0 02
			29 01 00 00 01 00 02 00 00
			29 01 00 00 01 00 02 01 04
			29 01 00 00 01 00 02 02 08
			29 01 00 00 01 00 02 03 05
			29 01 00 00 01 00 02 04 09
			29 01 00 00 01 00 02 05 06
			29 01 00 00 01 00 02 06 0A
			29 01 00 00 01 00 02 07 07
			29 01 00 00 01 00 02 08 0B
			29 01 00 00 01 00 02 09 1f
			29 01 00 00 01 00 02 0A 1f
			29 01 00 00 01 00 02 0B 1f
			29 01 00 00 01 00 02 0C 1f
			29 01 00 00 01 00 02 0D 1f
			29 01 00 00 01 00 02 0E 1f
			29 01 00 00 01 00 02 0F 17
			29 01 00 00 01 00 02 10 37
			29 01 00 00 01 00 02 11 10
			29 01 00 00 01 00 02 12 1F
			29 01 00 00 01 00 02 13 1F
			29 01 00 00 01 00 02 14 1F
			29 01 00 00 01 00 02 15 1F
			29 01 00 00 01 00 02 16 00
			29 01 00 00 01 00 02 17 04
			29 01 00 00 01 00 02 18 08
			29 01 00 00 01 00 02 19 05
			29 01 00 00 01 00 02 1A 09
			29 01 00 00 01 00 02 1B 06
			29 01 00 00 01 00 02 1C 0A
			29 01 00 00 01 00 02 1D 07
			29 01 00 00 01 00 02 1E 0B
			29 01 00 00 01 00 02 1F 1f
			29 01 00 00 01 00 02 20 1f
			29 01 00 00 01 00 02 21 1f
			29 01 00 00 01 00 02 22 1f
			29 01 00 00 01 00 02 23 1f
			29 01 00 00 01 00 02 24 1f
			29 01 00 00 01 00 02 25 17
			29 01 00 00 01 00 02 26 37
			29 01 00 00 01 00 02 27 10
			29 01 00 00 01 00 02 28 1F
			29 01 00 00 01 00 02 29 1F
			29 01 00 00 01 00 02 2A 1F
			29 01 00 00 01 00 02 2B 1F
			29 01 00 00 01 00 02 58 01
			29 01 00 00 01 00 02 59 00
			29 01 00 00 01 00 02 5A 00
			29 01 00 00 01 00 02 5B 00
			29 01 00 00 01 00 02 5C 01
			29 01 00 00 01 00 02 5D 30
			29 01 00 00 01 00 02 5E 00
			29 01 00 00 01 00 02 5F 00
			29 01 00 00 01 00 02 60 30
			29 01 00 00 01 00 02 61 00
			29 01 00 00 01 00 02 62 00
			29 01 00 00 01 00 02 63 03
			29 01 00 00 01 00 02 64 6A
			29 01 00 00 01 00 02 65 45
			29 01 00 00 01 00 02 66 08
			29 01 00 00 01 00 02 67 73
			29 01 00 00 01 00 02 68 05
			29 01 00 00 01 00 02 69 06
			29 01 00 00 01 00 02 6A 6A
			29 01 00 00 01 00 02 6B 08
			29 01 00 00 01 00 02 6C 00
			29 01 00 00 01 00 02 6D 00
			29 01 00 00 01 00 02 6E 00
			29 01 00 00 01 00 02 6F 88
			29 01 00 00 01 00 02 70 00
			29 01 00 00 01 00 02 71 00
			29 01 00 00 01 00 02 72 06
			29 01 00 00 01 00 02 73 7B
			29 01 00 00 01 00 02 74 00
			29 01 00 00 01 00 02 75 80
			29 01 00 00 01 00 02 76 00
			29 01 00 00 01 00 02 77 05
			29 01 00 00 01 00 02 78 10
			29 01 00 00 01 00 02 79 00
			29 01 00 00 01 00 02 7A 00
			29 01 00 00 01 00 02 7B 00
			29 01 00 00 01 00 02 7C 00
			29 01 00 00 01 00 02 7D 03
			29 01 00 00 01 00 02 7E 7B
			29 01 00 00 01 00 02 E0 01
			29 01 00 00 01 00 02 0E 01
			29 01 00 00 01 00 02 E0 03
			29 01 00 00 01 00 02 98 2F
			29 01 00 00 01 00 02 E0 04
			29 01 00 00 01 00 02 2B 2B
			29 01 00 00 01 00 02 2E 44
			29 01 00 00 01 00 02 E0 00
			29 01 00 00 01 00 02 35 00
			05 01 00 00 78 00 02 11 00
			05 01 00 00 14 00 02 29 00];
		qcom,mdss-dsi-off-command = [05 01 00 00 32 00 02 28 00
					05 01 00 00 78 00 02 10 00];
		qcom,mdss-dsi-on-command-state = "dsi_lp_mode";
		qcom,mdss-dsi-off-command-state = "dsi_hs_mode";
		qcom,mdss-dsi-h-sync-pulse = <1>;
		qcom,mdss-dsi-traffic-mode = "burst_mode";
		//qcom,mdss-dsi-panel-orientation = "180";
		//qcom,mdss-dsi-lane-map = "lane_map_0123";
		//qcom,esd-check-enabled;
		//qcom,mdss-dsi-panel-status-check-mode;
		qcom,mdss-dsi-bllp-eof-power-mode;
		qcom,mdss-dsi-bllp-power-mode;
		qcom,mdss-dsi-lp11-init;
		qcom,mdss-dsi-lane-0-state;
		qcom,mdss-dsi-lane-1-state;
		qcom,mdss-dsi-lane-2-state;
		qcom,mdss-dsi-lane-3-state;
		qcom,mdss-dsi-panel-timings = [86 1E 14 00 43 4B 19 21 22 03 04 00];
		qcom,mdss-dsi-t-clk-post = <0x04>;
		qcom,mdss-dsi-t-clk-pre = <0x1D>;
		qcom,mdss-dsi-bl-min-level = <1>;
		qcom,mdss-dsi-bl-max-level = <4095>;
		qcom,mdss-dsi-dma-trigger = "trigger_sw";
		qcom,mdss-dsi-mdp-trigger = "none";
		qcom,mdss-dsi-bl-pmic-control-type = "bl_ctrl_wled";
		qcom,mdss-dsi-reset-sequence = <1 20>, <0 50>, <1 100>;
		//add other LCM need this prop
		qcom,mdss-dsi-panel-timings-phy-v2 = [31 2A 11 14 0D 03 04 a0
		31 2A 11 14 0D 03 04 a0
		31 2A 11 14 0D 03 04 a0
		31 2A 11 14 0D 03 04 a0
		31 3E 11 14 0D 03 04 a0];
		qcom,panel-supply-entries = <&dsi_panel_pwr_supply>;
		//add end
	};
};

