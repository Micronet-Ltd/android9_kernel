/* Copyright (c) 2015-2016, The Linux Foundation. All rights reserved.
 *
 * This program is free software; you can redistribute it and/or modify
 * it under the terms of the GNU General Public License version 2 and
 * only version 2 as published by the Free Software Foundation.
 *
 * This program is distributed in the hope that it will be useful,
 * but WITHOUT ANY WARRANTY; without even the implied warranty of
 * MERCHANTABILITY or FITNESS FOR A PARTICULAR PURPOSE.  See the
 * GNU General Public License for more details.
 */

qcom,c801_scap_4v2_135mah_30k {
	/* #batterydata-scap-c801-4v2-135mah_30k_FG_averaged_MasterSlave_Apr8th2020*/
	qcom,max-voltage-uv = <4200000>;
	qcom,fastchg-current-ma = <300>;
	qcom,fg-cc-cv-threshold-mv = <4190>;
	qcom,nom-batt-capacity-mah = <135>;
	qcom,batt-id-kohm = <22>;
	qcom,battery-beta = <3440>;
	qcom,battery-type = "c801_scap_4v2_135mah_30k";
	qcom,chg-rslow-comp-c1 = <1520389>;
	qcom,chg-rslow-comp-c2 = <2485752>;
	qcom,chg-rs-to-rslow = <1476733>;
	qcom,chg-rslow-comp-thr = <0xB4>;
	qcom,checksum = <0xE772>;
	qcom,gui-version = "PMI8950GUI - 2.0.0.16";
	qcom,fg-profile-data = [
		 30 88 EA 7F 
		 34 82 6F 7C 
		 38 83 03 72 
		 DA 7C A8 78 
		 0A 82 4F 98 
		 D4 B4 75 BB 
		 A1 1B D0 83 
		 6C 76 59 7A 
		 D7 6F 30 83 
		 EC 78 AF 85 
		 75 81 24 82 
		 E5 98 C1 B6 
		 7D C2 75 16 
		 90 00 1A 62 
		 FB 6A E6 FF 
		 51 4C C4 07 
		 37 42 00 00 
		 1C 47 43 38 
		 3F 21 00 00 
		 00 00 00 00 
		 00 00 00 00 
		 58 78 24 79 
		 9F 5A 7A 53 
		 5E 64 B1 64 
		 00 69 8B 6A 
		 B5 53 FD 65 
		 EB 8D F7 BB 
		 14 6A 6B 6A 
		 6C A0 71 0C 
		 28 00 FF 36 
		 F0 11 30 03 
		 00 00 00 0C 
	];
};
